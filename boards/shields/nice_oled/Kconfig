## boards/shields/nice_oled/Kconfig
```kconfig
config SHIELD_NICE_OLED
  bool "Nice OLED display shield"
  depends on ZMK_DISPLAY
```

## config/west.yml
```yaml
manifest:
  remotes:
    - name: mctechnology17
      url-base: https://github.com/mctechnology17
      # Additional modules containing boards/shields/custom code can be listed here as well.
      # See:
      # - https://zmk.dev/docs/features/modules
      # - https://docs.zephyrproject.org/3.5.0/develop/west/manifest.html#projects
    - name: gpeye
      url-base: https://github.com/GPeye
  projects:
    - name: mario-peripheral-animation
      remote: gpeye
      revision: main 
    - name: zmk
      remote: mctechnology17
      revision: nice0_view_driver
      import: app/west.yml
  self:
    path: boards
```
